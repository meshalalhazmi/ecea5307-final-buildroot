## base_external/Config.in
```kconfig
menu "External packages"
	source "$BR2_EXTERNAL_package_base_PATH/package/clock_epaper_app/Config.in"
endmenu
```

## base_external/package/clock_epaper_app/Config.in
```kconfig
config BR2_PACKAGE_CLOCK_EPAPER_APP
	bool "clock_epaper_app"
	help
	  Minimal e-paper clock app that renders the current time once per minute.
	  Uses the system time (RTC initialized earlier in boot).
```
